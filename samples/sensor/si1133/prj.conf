## CMakeLists.txt
```
#
# Copyright (c) 2018 Linaro Ltd.
#
# SPDX-License-Identifier: Apache-2.0
#

cmake_minimum_required(VERSION 3.13.1)
find_package(Zephyr REQUIRED HINTS $ENV{ZEPHYR_BASE})
project(si1133)

FILE(GLOB app_sources src/*.c)
target_sources(app PRIVATE ${app_sources})
```

## Kconfig
```
mainmenu "SI1133"

choice
	prompt "SI1133 Trigger On"
	default APP_TRIGGER_ON_DATAREADY
	depends on SI1133_TRIGGER
	help
	  Select the type of trigger to use

config APP_TRIGGER_ON_DATAREADY
	bool "Trigger on data ready"

endchoice

CONFIG_STDOUT_CONSOLE=y
CONFIG_I2C=y
CONFIG_SENSOR=y
CONFIG_SI1133=y

source "Kconfig.zephyr"
```

## sample.yaml
```
#
# Copyright (c) 2018 Linaro Ltd.
#
# SPDX-License-Identifier: Apache-2.0
#

sample:
  description: Demonstration of the SI1133 Digital Ambient light sensor
  name: SI1133 sample
tests:
  sample.sensor.ccs811:
    harness: sensor
    tags: sensors
    platform_allow: thingy52_nrf52832 efr32mg_sltb004a
    integration_platforms:
      - efr32mg_sltb004a
    depends_on: i2c
```

## prj.conf
```kconfig
#
# Copyright (c) 2018 Linaro Ltd.
#
# SPDX-License-Identifier: Apache-2.0
#

CONFIG_STDOUT_CONSOLE=y
CONFIG_I2C=y
CONFIG_SENSOR=y
CONFIG_SI1133=y
```

## src/main.c
```c
/*
 * Copyright (c) 2012-2014 Wind River Systems, Inc.
 * Copyright (c) 2021 Nordic Semiconductor ASA
 *
 * SPDX-License-Identifier: Apache-2.0
 */

#include <zephyr.h>
#include <device.h>
#include <devicetree.h>
#include <drivers/sensor.h>
#include <sys/printk.h>
//#include <drivers/sensor/si1133.h>
#include <stdio.h>




void main(void)
{
	const struct device *dev = device_get_binding(DT_LABEL(DT_INST(0, silabs_si1133)));
	//printk("hello\n");

	if (dev == NULL) {
		return;
	}
	//printk("waiting\n");

	k_msleep(1000);
	
	while (1) {
		//printk("hello2\n");

		struct sensor_value white, uv, ir;

		sensor_sample_fetch(dev);
		sensor_channel_get(dev, SENSOR_CHAN_LIGHT, &white);
		sensor_channel_get(dev, SENSOR_CHAN_IR, &ir);
		sensor_channel_get(dev, SENSOR_CHAN_UV, &uv);
	
		printk("large white : %u\n",white.val1);
		printk("Large IR: %u\n",ir.val1);
		printk("UV: %u\n",uv.val1);
		
	
		k_msleep(1000);
	}
}
```
