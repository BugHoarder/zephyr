## drivers/sensor/si1133/Kconfig
```kconfig
# Si1133, I2C UV Index/Ambient Light Sensor.

menuconfig SI1133
	bool "SI1133 UV Index/Ambient Light I2C Sensor"
	depends on I2C
	help
	  Enable driver for SI1133 UV Index/Ambient Light Sensor.
```

## dts/bindings/sensor/silabs,si1133.yaml
```yaml
    # Copyright (c) 2018, Linaro Limited
# SPDX-License-Identifier: Apache-2.0

description: SI1133 UV and visible light sensor

compatible: "silabs,si1133"

include: i2c-device.yaml

properties:
    supply-gpios:
      type: phandle-array
      required: false
      description: |
        The WAKEn pin is asserted to communicate with the sensor.  The
        sensor receives this as an active-low signal.

    reset-gpios:
      type: phandle-array
      required: false
      description: |
        The RESETn pin is asserted to disable the sensor causing a hard
        reset.  The sensor receives this as an active-low signal.

    irq-gpios:
      type: phandle-array
      required: false
      description: |
        The INTn pin signals that a new reading is available.  The
        sensor generates an active-low level signal which remains
        asserted until the data is read.
```
